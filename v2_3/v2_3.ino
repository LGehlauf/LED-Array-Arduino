#include <Adafruit_NeoPixel.h>
#include <avr/power.h>

const uint16_t RainbowArrLength = 1800;

const PROGMEM float RainbowR[1800] = {0.0,0.0,0.0,0.0,0.0,0.0,0.0,0.0,0.0,0.0,0.0,0.0,0.0,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0.03974,0.01993};
const PROGMEM float RainbowG[1800] = {0.0,0.01993,0.03974,0.05941,0.07895,0.09836,0.11765,0.13681,0.15584,0.17476,0.19355,0.21222,0.23077,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0.0,0.0};
const PROGMEM float RainbowB[1800] = {6.0,5.98007,5.96026,5.94059,5.92105,5.90164,5.88235,5.86319,5.84416,5.82524,5.80645,5.78778,5.76923,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5.96026,5.98007};

struct Button {
  uint8_t pin;
  uint8_t mode;  //determined by how often button was pressed
  bool stateNew;
  bool stateOld;
};

struct LightValues {
  float r;
  float g;
  float b;
  uint8_t h;  //brightness -> german "Helligkeit"
};

struct Button button1 {
  5, 0, false, false
};  //0 = off, 3 = rainbow, 
struct Button button2 {
  6, 3, false, false
};  //starts with mode 3 = brightness offset 13 at brightnessTable[3]
struct Button button3 {
  7, 0, false, false
};

struct LightValues lv {
  0, 0, 0, 0
};

const int8_t colorTable[27] = { 0, 0, 0, 0, 0, 0, 6, 0, 0, 0, 6, 0, 0, 0, 6, 3, 3, 0, 0, 3, 3, 3, 0, 3, 2, 2, 2 };
const uint8_t brightnessTable[6] = { 4, 7, 13, 21, 30, 42 };

const uint8_t NUMPIXELS = 146;  //amount of LEDs
const uint8_t LEDPIN = 12;      //LED pin
const uint8_t MICPIN = 4;
Adafruit_NeoPixel pixels = Adafruit_NeoPixel(NUMPIXELS, LEDPIN, NEO_GRB + NEO_KHZ800);

const unsigned long ProgramDuration = 5000;  //in microseconds

void setup() {
  //Serial.begin(9600);
  //delay(1000);
  pinMode(LEDPIN, OUTPUT);
  pinMode(button1.pin, INPUT);
  pinMode(button2.pin, INPUT);
  pinMode(button3.pin, INPUT);
  pixels.begin();
  lv.r = colorTable[0 + button1.mode];
  lv.g = colorTable[1 + button1.mode];
  lv.b = colorTable[2 + button1.mode];
  lv.h = brightnessTable[button2.mode];
  setAllPixelColor(lv.r, lv.g, lv.b, lv.h);
  pixels.show();

/*
  Serial.println("PDec\tMovMin\tOutli\tR\tG\tB\tH");                            // DEBUG MODE
  const int ende = 150;
  float endeende = 150.0;
  int arr[ende] = {0};
  unsigned long sum = 0;
  float arithMean = 0;
  float stanDev = 0;
  unsigned long StartTestDuration = millis();
  unsigned long arrMin = 100000;
  unsigned long arrMax = 0;
  for(int i=0; i < ende; i++){
    arr[i] = PTester();
    delay(10);
    sum += arr[i];
  }
  Serial.print("Test Duration (millis): ");
  Serial.println(millis() - StartTestDuration);
  arithMean = (float)sum / endeende;
  for(int i=0; i < ende; i++){
    stanDev += pow((arr[i] - arithMean), 2);
    if (arr[i] > arrMax){
      arrMax = arr[i];
    }
    if (arr[i] < arrMin){
      arrMin = arr[i];
    }
    //Serial.print(arr[i]);
    //Serial.print("\t");
    //if (i % 18 == 0) Serial.println();
  }
  Serial.println();
  stanDev = sqrt(stanDev / endeende);
  Serial.print("arrMin: ");
  Serial.print(arrMin);
  Serial.print("  arrMax: ");
  Serial.print(arrMax); 
  Serial.print("  mean: ");
  Serial.print(arithMean);
  Serial.print("  standard Deviation: ");
  Serial.println(stanDev);
  */
}

void loop() {
  PTester();
  
}

void PTester(){
  unsigned long startTime = micros();

  // Rainbow iteration
  static uint16_t RainbowIterator = 0;
  RainbowIterator = (RainbowIterator + 1) % RainbowArrLength;
  // if (RainbowIterator > RainbowArrLength) RainbowIterator = 0;

  pixels.show();
  button1.stateNew = digitalRead(7);
  button2.stateNew = digitalRead(6);
  button3.stateNew = digitalRead(5);

  //button 1, change led color
  if ((button1.stateNew != button1.stateOld) && button1.stateNew) {
    button1.mode = (button1.mode + 3) % 27;
  }
  button1.stateOld = button1.stateNew;
  if (button1.mode == 3) {
    float RainbowR_R = pgm_read_float_near(RainbowR + RainbowIterator);  // special syntax for reading from sram
    float RainbowG_G = pgm_read_float_near(RainbowG + RainbowIterator);
    float RainbowB_B = pgm_read_float_near(RainbowB + RainbowIterator);
    lv.r = RainbowR_R;
    lv.g = RainbowG_G;
    lv.b = RainbowB_B;
  } else {
    lv.r = colorTable[0 + button1.mode];
    lv.g = colorTable[1 + button1.mode];
    lv.b = colorTable[2 + button1.mode];
  }
  

  //##########################################
  //button 2, change brightness
  if ((button2.stateNew != button2.stateOld) && button2.stateNew) {
    button2.mode = (button2.mode + 1) % 6;

    lv.h = brightnessTable[button2.mode];
  }
  button2.stateOld = button2.stateNew;

  //#########################################
  //button 3, change between modes like breathing light
  if ((button3.stateNew != button3.stateOld) && button3.stateNew) {
    button3.mode = (button3.mode + 1);  // % 2 -> num of modes
    if (button3.mode == 2) button3.mode = 0;
  }
  button3.stateOld = button3.stateNew;

  uint16_t peakDetector = analogRead(MICPIN);
  static uint16_t movingMin = 0;
  //uint16_t movingMinDEBUGIGNORE = 0;
  //movingMinDEBUGIGNORE = movingMIN(peakDetector);                               // DEBUG MODE
  movingMin = movingMIN(peakDetector);
  //uint16_t outlier = abs(movingMin * 0.060);                                    // DEBUG MODE
  uint16_t outlier = abs(peakDetector - movingMin);                                               
  uint8_t flash = brightnessTable[button2.mode];
  /*Serial.print(peakDetector);
  Serial.print("\t");
  Serial.print(movingMin);
  Serial.print("\t");
  Serial.print(outlier);
  Serial.print("\t");
  */
  switch (button3.mode) {
    case 1:

      if (outlier < (movingMin * 0.065)) {
        flash = round(1.0 * flash);
      } else if (outlier < (movingMin * 0.087)) {
        flash = round(1.05 * flash);
      } else if (outlier < (movingMin * 0.12)) {
        flash = round(1.1 * flash);
      } else if (outlier < (movingMin * 0.16)) {
        flash = round(1.15 * flash);
      } else if (outlier < (movingMin * 0.21)) {
        flash = round(1.2 * flash);
      } else if (outlier < (movingMin * 0.29)) {
        flash = round(1.25 * flash);
      } else if (outlier < (movingMin * 0.38)) {
        flash = round(1.3 * flash);
      } else if (outlier < (movingMin * 0.52)) {
        flash = round(1.35 * flash);
      } else flash = round(1.4 * flash);
      if (flash > 42) flash = 42;
      setAllPixelColor(lv.r, lv.g, lv.b, flash);

      break;
    default:
      setAllPixelColor(lv.r, lv.g, lv.b, lv.h);
      break;
  }
  
    
  unsigned long PDuration = micros() - startTime;
  for (;;) {  // consumes remaining time to ensure even flow
    if (micros() - startTime >= ProgramDuration){
      break;
    }
  }
  
  //return PDuration;
} 

void setAllPixelColor(float _r, float _g, float _b, uint8_t _h) {
  uint8_t r = round(_r * _h);
  uint8_t g = round(_g * _h);
  uint8_t b = round(_b * _h);
  /*
  Serial.print(r);
  Serial.print("\t");
  Serial.print(g);
  Serial.print("\t");
  Serial.print(b);
  Serial.print("\t");
  Serial.println(_h);
  */
  for (int i = 0; i < NUMPIXELS; i++) {
    pixels.setPixelColor(i, pixels.Color(r, g, b));
  }
  return;
}

uint16_t movingMIN(uint16_t sample) {
  float movingMIN = sample;
  static uint16_t samples[100] = {2000};
  static uint8_t i = 0;
  samples[i % 100] = sample;
  i++;
  for (uint8_t j = 0; j < 100; j++) {
    if (samples[j] < movingMIN) movingMIN = samples[j];
  }
  return movingMIN;
}
